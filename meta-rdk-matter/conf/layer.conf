## meta-rdk-matter/conf/layer.conf
```bitbake
BBPATH .= ":${LAYERDIR}"
# Ensure new recipe dirs are visible
BBFILES += "${LAYERDIR}/recipes-matter/*/*/*.bb ${LAYERDIR}/recipes-matter/*/*.bb ${LAYERDIR}/recipes-thread/*/*.bbappend ${LAYERDIR}/recipes-matter/*/*.bbappend ${LAYERDIR}/recipes-connectivity/*/*.bbappend ${LAYERDIR}/recipes-core/*/*.bbappend ${LAYERDIR}/recipes-core/images/*.bbappend"
BBFILES += "\
  ${LAYERDIR}/recipes-*/*/*.bb \
  ${LAYERDIR}/recipes-*/*/*/*.bb \
  ${LAYERDIR}/recipes-*/*/*.bbappend \
"

BBFILE_COLLECTIONS += "rdk-matter"
BBFILE_PATTERN_rdk-matter := "^${LAYERDIR}/"
BBFILE_PRIORITY_rdk-matter = "6"

LAYERSERIES_COMPAT_rdk-matter = "dunfell kirkstone"
```
